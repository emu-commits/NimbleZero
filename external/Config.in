## external/Config.in
```kconfig
menu "Cardputer Zero"
	source "$BR2_EXTERNAL_NZ_PATH/package/nz-drivers/Config.in"
	source "$BR2_EXTERNAL_NZ_PATH/package/nz-wifi-nvram/Config.in"
	source "$BR2_EXTERNAL_NZ_PATH/package/nz-diag/Config.in"
	source "$BR2_EXTERNAL_NZ_PATH/package/dpkg/Config.in"
	source "$BR2_EXTERNAL_NZ_PATH/package/nz-compat/Config.in"
	source "$BR2_EXTERNAL_NZ_PATH/package/nz-launcher/Config.in"
	source "$BR2_EXTERNAL_NZ_PATH/package/emuzero-launcher/Config.in"
	source "$BR2_EXTERNAL_NZ_PATH/package/nz-apps/Config.in"
	source "$BR2_EXTERNAL_NZ_PATH/package/nz-libcamera/Config.in"
	source "$BR2_EXTERNAL_NZ_PATH/package/nz-fmt10/Config.in"
endmenu
```

## external/configs/nz_compat_defconfig
```kconfig
BR2_aarch64=y
BR2_cortex_a53=y
BR2_OPTIMIZE_2=y
BR2_TOOLCHAIN_EXTERNAL=y
BR2_TOOLCHAIN_EXTERNAL_BOOTLIN=y
BR2_TOOLCHAIN_EXTERNAL_BOOTLIN_AARCH64_GLIBC_STABLE=y
BR2_DOWNLOAD_FORCE_CHECK_HASHES=y
BR2_GLOBAL_PATCH_DIR="$(BR2_EXTERNAL_NZ_PATH)/patches"
BR2_TARGET_GENERIC_HOSTNAME="nimblezero"
BR2_TARGET_GENERIC_ISSUE="NimbleZero"
BR2_SYSTEM_DHCP=""
BR2_ROOTFS_OVERLAY="$(BR2_EXTERNAL_NZ_PATH)/board/cardputerzero/rootfs-overlay"
BR2_ROOTFS_POST_BUILD_SCRIPT="$(BR2_EXTERNAL_NZ_PATH)/board/cardputerzero/post-build.sh"
BR2_ROOTFS_POST_IMAGE_SCRIPT="$(BR2_EXTERNAL_NZ_PATH)/board/cardputerzero/post-image.sh"
BR2_LINUX_KERNEL=y
BR2_LINUX_KERNEL_CUSTOM_TARBALL=y
BR2_LINUX_KERNEL_CUSTOM_TARBALL_LOCATION="$(call github,raspberrypi,linux,0b41724521c9adf5399409d02aece6c1df0a4432)/linux-0b41724521c9adf5399409d02aece6c1df0a4432.tar.gz"
BR2_LINUX_KERNEL_DEFCONFIG="bcm2711"
BR2_LINUX_KERNEL_CONFIG_FRAGMENT_FILES="$(BR2_EXTERNAL_NZ_PATH)/board/cardputerzero/linux.fragment"
BR2_LINUX_KERNEL_DTS_SUPPORT=y
BR2_LINUX_KERNEL_INTREE_DTS_NAME="broadcom/bcm2710-rpi-cm0 broadcom/bcm2710-rpi-zero-2-w broadcom/bcm2710-rpi-3-b"
BR2_LINUX_KERNEL_NEEDS_HOST_OPENSSL=y
BR2_PACKAGE_BUSYBOX_SHOW_OTHERS=y
BR2_PACKAGE_RPI_FIRMWARE=y
BR2_PACKAGE_RPI_FIRMWARE_BOOTCODE_BIN=y
BR2_PACKAGE_RPI_FIRMWARE_VARIANT_PI=y
BR2_PACKAGE_RPI_FIRMWARE_CONFIG_FILE="$(BR2_EXTERNAL_NZ_PATH)/board/cardputerzero/config.txt"
BR2_PACKAGE_RPI_FIRMWARE_CMDLINE_FILE="$(BR2_EXTERNAL_NZ_PATH)/board/cardputerzero/cmdline.txt"
BR2_PACKAGE_BRCMFMAC_SDIO_FIRMWARE_RPI=y
BR2_PACKAGE_BRCMFMAC_SDIO_FIRMWARE_RPI_BT=y
BR2_PACKAGE_BRCMFMAC_SDIO_FIRMWARE_RPI_WIFI=y
BR2_PACKAGE_NZ_WIFI_NVRAM=y
BR2_PACKAGE_WIRELESS_REGDB=y
BR2_PACKAGE_KMOD=y
BR2_PACKAGE_KMOD_TOOLS=y
BR2_PACKAGE_DROPBEAR=y
BR2_PACKAGE_WPA_SUPPLICANT=y
BR2_PACKAGE_WPA_SUPPLICANT_NL80211=y
BR2_PACKAGE_WPA_SUPPLICANT_CLI=y
BR2_PACKAGE_WPA_SUPPLICANT_PASSPHRASE=y
BR2_PACKAGE_I2C_TOOLS=y
BR2_PACKAGE_EVTEST=y
BR2_PACKAGE_ALSA_UTILS=y
BR2_PACKAGE_ALSA_UTILS_AMIXER=y
BR2_PACKAGE_ALSA_UTILS_APLAY=y
BR2_PACKAGE_E2FSPROGS=y
BR2_PACKAGE_E2FSPROGS_RESIZE2FS=y
BR2_TARGET_ROOTFS_EXT2=y
BR2_TARGET_ROOTFS_EXT2_4=y
BR2_TARGET_ROOTFS_EXT2_SIZE="768M"
BR2_PACKAGE_HOST_DOSFSTOOLS=y
BR2_PACKAGE_HOST_GENIMAGE=y
BR2_PACKAGE_HOST_MTOOLS=y
BR2_PACKAGE_NZ_DRIVERS=y
BR2_PACKAGE_NZ_DIAG=y
BR2_TARGET_GENERIC_ROOT_PASSWD=""
BR2_ROOTFS_USERS_TABLES="$(BR2_EXTERNAL_NZ_PATH)/board/cardputerzero/users.table"
BR2_ROOTFS_POST_FAKEROOT_SCRIPT="$(BR2_EXTERNAL_NZ_PATH)/board/cardputerzero/post-fakeroot.sh"
BR2_TARGET_ROOTFS_EXT2_MKFS_OPTIONS="-O ^64bit,^orphan_file -E lazy_itable_init=0,lazy_journal_init=0"
BR2_PACKAGE_SUDO=y
BR2_PACKAGE_IW=y
BR2_TARGET_TZ_INFO=y
BR2_TARGET_TZ_ZONELIST="default"
BR2_TARGET_LOCALTIME="Etc/UTC"
BR2_PACKAGE_BUSYBOX_CONFIG_FRAGMENT_FILES="$(BR2_EXTERNAL_NZ_PATH)/board/cardputerzero/busybox.fragment"
BR2_PACKAGE_LIBCURL=y
BR2_PACKAGE_LIBCURL_CURL=y
BR2_PACKAGE_OPENSSL=y
BR2_PACKAGE_LIBOPENSSL_BIN=y
BR2_PACKAGE_LIBCURL_OPENSSL=y
BR2_PACKAGE_CA_CERTIFICATES=y
BR2_PACKAGE_FREETYPE=y
BR2_PACKAGE_LIBGLIB2=y
BR2_PACKAGE_LIBINPUT=y
BR2_PACKAGE_LIBXKBCOMMON=y
BR2_PACKAGE_XKEYBOARD_CONFIG=y
BR2_PACKAGE_BASH=y
BR2_PACKAGE_UTIL_LINUX=y
BR2_PACKAGE_UTIL_LINUX_BINARIES=y
BR2_PACKAGE_DPKG=y
BR2_PACKAGE_NZ_COMPAT=y
BR2_PACKAGE_PROCPS_NG=y
BR2_PACKAGE_WGET=y
BR2_PACKAGE_COREUTILS=y
BR2_PACKAGE_XORG7=y
BR2_PACKAGE_XLIB_LIBX11=y
BR2_PACKAGE_NZ_LAUNCHER=y
BR2_PACKAGE_HTOP=y
BR2_PACKAGE_NANO=y
BR2_ENABLE_LOCALE_WHITELIST="C en_US en_US.UTF-8 compose.dir locale.alias"
BR2_PACKAGE_DBUS=y
BR2_PACKAGE_NZ_APPS=y
BR2_PACKAGE_PULSEAUDIO=y
BR2_PACKAGE_PULSEAUDIO_DAEMON=y
BR2_PACKAGE_LIBV4L=y
BR2_PACKAGE_LIBV4L_UTILS=y
BR2_PACKAGE_FFMPEG=y
BR2_PACKAGE_FFMPEG_GPL=y
BR2_PACKAGE_FFMPEG_FFMPEG=y
BR2_PACKAGE_FFMPEG_FFPROBE=y
BR2_PACKAGE_FFMPEG_POSTPROC=y
BR2_PACKAGE_FFMPEG_SWSCALE=y
BR2_PACKAGE_FFMPEG_ENCODERS="all"
BR2_PACKAGE_FFMPEG_DECODERS="all"
BR2_PACKAGE_FFMPEG_MUXERS="all"
BR2_PACKAGE_FFMPEG_DEMUXERS="all"
BR2_PACKAGE_FFMPEG_PARSERS="all"
BR2_PACKAGE_FFMPEG_BSFS="all"
BR2_PACKAGE_FFMPEG_PROTOCOLS="all"
BR2_PACKAGE_FFMPEG_FILTERS="all"
BR2_PACKAGE_FFMPEG_INDEVS=y
BR2_PACKAGE_FFMPEG_OUTDEVS=y
BR2_PACKAGE_X264=y
BR2_PACKAGE_X265=y
BR2_PACKAGE_LIBVPX=y
BR2_PACKAGE_DAV1D=y
BR2_PACKAGE_OPUS=y
BR2_PACKAGE_LAME=y
BR2_PACKAGE_LIBVORBIS=y
BR2_PACKAGE_LIBTHEORA=y
BR2_PACKAGE_SPEEX=y
BR2_PACKAGE_OPENJPEG=y
BR2_PACKAGE_LIBXML2=y
BR2_PACKAGE_LIBSOXR=y
BR2_PACKAGE_FONTCONFIG=y
BR2_PACKAGE_HARFBUZZ=y
BR2_PACKAGE_LIBFRIBIDI=y
BR2_PACKAGE_LIBASS=y
BR2_PACKAGE_LIBDRM=y
BR2_PACKAGE_BZIP2=y
BR2_PACKAGE_GNUTLS=y
BR2_PACKAGE_PYTHON3=y
BR2_PACKAGE_PYTHON3_SSL=y
BR2_PACKAGE_PYTHON3_SQLITE=y
BR2_PACKAGE_PYTHON3_ZLIB=y
BR2_PACKAGE_PYTHON3_BZIP2=y
BR2_PACKAGE_PYTHON3_XZ=y
BR2_PACKAGE_PYTHON3_CURSES=y
BR2_PACKAGE_PYTHON3_READLINE=y
BR2_PACKAGE_PYTHON3_PYEXPAT=y
BR2_PACKAGE_PYTHON3_UNICODEDATA=y
BR2_PACKAGE_PYTHON3_DECIMAL=y
BR2_PACKAGE_JPEG=y
BR2_PACKAGE_PYTHON_PILLOW=y
BR2_PACKAGE_PYTHON_NUMPY=y
BR2_PACKAGE_PYTHON_EVDEV=y
BR2_PACKAGE_PYTHON_QRCODE=y
BR2_PACKAGE_PYTHON_REQUESTS=y
BR2_PACKAGE_DEJAVU=y
BR2_PACKAGE_LIBPNG=y
BR2_PACKAGE_SDL2=y
BR2_PACKAGE_SDL2_TTF=y
BR2_PACKAGE_SDL2_IMAGE=y
BR2_PACKAGE_SDL2_MIXER=y
BR2_PACKAGE_NZ_LIBCAMERA=y
BR2_PACKAGE_NZ_FMT10=y
BR2_PACKAGE_CJSON=y
BR2_TARGET_GENERIC_GETTY=n
BR2_PACKAGE_NZ_COMPAT_SHIMS=y
BR2_ROOTFS_DEVICE_CREATION_DYNAMIC_EUDEV=y
```

## external/package/emuzero-launcher/Config.in
```kconfig
config BR2_PACKAGE_EMUZERO_LAUNCHER
	bool "emuzero-launcher (emuZero launcher, LVGL)"
	depends on BR2_USE_MMU
	select BR2_PACKAGE_FREETYPE
	select BR2_PACKAGE_LIBPNG
	select BR2_PACKAGE_SQLITE
	select BR2_PACKAGE_ZLIB
	help
	  The emuZero launcher: a thin LVGL front end for NimbleZero's
	  apps, Settings, Wi-Fi and Store. Installs
	  /usr/bin/emuzero-launcher and its themes (and, from sources that
	  have them, the Notes and Wiki apps); Options > Launcher
	  at start offers it, and an entry in the M5 launcher's app
	  list changes over to it.

	  LVGL 9.2.2 is built into the program (MIT).

	  https://github.com/emu-commits/emuzero-launcher
```

## external/package/nz-apps/Config.in
```kconfig
config BR2_PACKAGE_NZ_APPS
	bool "nz-apps (native example applications and launcher entries)"
	depends on BR2_PACKAGE_NZ_LAUNCHER
	help
	  Launcher entries (.desktop files) and small applications that
	  exercise the three application styles: a graphical nzui app
	  (snake), terminal programs (shell, htop when present)
	  and networking tools (Wi-Fi setup, network info, SSH client).
```

## external/package/nz-fmt10/Config.in
```kconfig
config BR2_PACKAGE_NZ_FMT10
	bool "nz-fmt10 (libfmt.so.10 runtime for M5Stack apps)"
	depends on BR2_INSTALL_LIBSTDCPP
	help
	  The shared library of {fmt} 10 (Debian name libfmt10), which
	  M5Stack's camera app and several apps of the M5 index link.
	  Only libfmt.so.10 is installed: no headers, so it does not
	  clash with Buildroot's newer fmt package.

	  https://fmt.dev
```

## external/package/nz-libcamera/Config.in
```kconfig
config BR2_PACKAGE_NZ_LIBCAMERA
	bool "nz-libcamera (Raspberry Pi libcamera 0.8, for M5Stack camera apps)"
	depends on !BR2_PACKAGE_LIBCAMERA
	depends on BR2_INSTALL_LIBSTDCPP
	depends on BR2_TOOLCHAIN_HAS_THREADS
	depends on BR2_TOOLCHAIN_GCC_AT_LEAST_9
	select BR2_PACKAGE_GNUTLS
	select BR2_PACKAGE_LIBYAML
	help
	  Raspberry Pi's libcamera tree at the release that M5Stack's
	  camera apps are built against (Debian names libcamera0.8 and
	  libcamera-ipa).  Buildroot's own libcamera package is an older
	  release with another library version, which those apps cannot
	  load.  Only the rpi/vc4 pipeline and its IPA (ISP control and
	  sensor tuning files, IMX219 included) are built.

	  https://github.com/raspberrypi/libcamera

comment "nz-libcamera needs a toolchain w/ C++, threads, gcc >= 9"
	depends on !BR2_INSTALL_LIBSTDCPP || !BR2_TOOLCHAIN_HAS_THREADS || \
		!BR2_TOOLCHAIN_GCC_AT_LEAST_9
```
